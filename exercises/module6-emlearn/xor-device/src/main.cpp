// Module 6 — XOR Random Forest (emlearn) on the RAK4631.
//
// Type two numbers in [0,1] separated by whitespace into the serial monitor
// (115200 baud) and press Enter:
//     0.9 0.1        ->  class 1 (XOR true),  green LED
//     0.9 0.8        ->  class 0 (XOR false), blue LED
//
// The model header is generated by ../xor-train/train_xor.py and copied into
// include/ — see include/README.md. Recent emlearn versions #include
// <eml_trees.h> even with method='inline', so the emlearn runtime headers
// must be copied into lib/emlearn — see README Part 1 and platformio.ini.

#include <Arduino.h>
#include <Adafruit_TinyUSB.h>  // provides USB-CDC `Serial` on the Adafruit nRF52 BSP
#include <stdlib.h>      // strtod — no scanf float dependency (newlib-nano)

#include "xor_model.h"   // generated — defines xor_model_predict()
// The generated predict function is `<name>_predict`, and emlearn's tree runtime
// is fixed-point, so its signature is:
//     int32_t xor_model_predict(const int16_t *features, int32_t features_length)
// If your emlearn version names it differently, open xor_model.h and adjust.

#define N_FEATURES 2

// MUST equal FEATURE_SCALE in ../xor-train/train_xor.py. The model's split
// thresholds are integers in these units (~104, ~7, ...), so scaling the input
// differently here silently moves every decision boundary — the model would
// still run and still look plausible, which is the worst kind of wrong.
#define FEATURE_SCALE 255

static char linebuf[64];
static char outbuf[96];

static bool read_two_floats(float *a, float *b)
{
    size_t len = Serial.readBytesUntil('\n', linebuf, sizeof(linebuf) - 1);
    if (len == 0) return false;
    linebuf[len] = '\0';

    // strtod instead of sscanf("%f %f"): newlib-nano only supports %f in
    // scanf if _scanf_float is linked in — strtod always works.
    char *end1 = NULL;
    const double v1 = strtod(linebuf, &end1);   // skips leading whitespace
    if (end1 == linebuf) return false;          // no number parsed
    char *end2 = NULL;
    const double v2 = strtod(end1, &end2);
    if (end2 == end1) return false;             // second number missing
    *a = (float)v1;
    *b = (float)v2;
    return true;
}

void setup()
{
    pinMode(LED_GREEN, OUTPUT);
    pinMode(LED_BLUE, OUTPUT);
    Serial.begin(115200);
    uint32_t t0 = millis();
    while (!Serial && millis() - t0 < 5000) { delay(10); }
    Serial.setTimeout(60000);   // wait patiently for typed input
    Serial.println("# emlearn XOR classifier ready.");
    Serial.println("# enter: <feature0> <feature1>   e.g.  0.9 0.1");
}

void loop()
{
    float typed[N_FEATURES];

    if (!read_two_floats(&typed[0], &typed[1])) {
        return;   // no/invalid input yet — keep waiting
    }

    // Quantise exactly as train_xor.py did: [0,1] -> 0..FEATURE_SCALE, int16.
    // This is the whole point of the fixed-point tree runtime — no FPU needed
    // at inference time, just integer compares.
    int16_t features[N_FEATURES];
    for (int i = 0; i < N_FEATURES; i++) {
        float v = typed[i] * (float)FEATURE_SCALE;
        if (v < 0.0f) v = 0.0f;                        // clamp: the model never
        if (v > (float)FEATURE_SCALE) v = FEATURE_SCALE;  // saw out-of-range data
        features[i] = (int16_t)(v + 0.5f);             // round, don't truncate
    }

    uint32_t t0 = micros();
    int32_t out = xor_model_predict(features, N_FEATURES);
    uint32_t latency = micros() - t0;

    digitalWrite(LED_GREEN, out == 1 ? HIGH : LOW);
    digitalWrite(LED_BLUE, out == 0 ? HIGH : LOW);

    snprintf(outbuf, sizeof(outbuf),
             "in=(%.2f, %.2f) = (%d, %d) -> class %ld (XOR %s)   latency=%lu us",
             (double)typed[0], (double)typed[1],
             (int)features[0], (int)features[1],
             (long)out, out == 1 ? "true" : "false",
             (unsigned long)latency);
    Serial.println(outbuf);
}
