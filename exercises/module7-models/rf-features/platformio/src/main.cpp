/*
 * Module 7.1 - Live fan-state classification on RAK4631 (nRF52840)
 * Random Forest (emlearn) on 13 statistical features, LIS3DH polled at 250 Hz.
 *
 * Pipeline: LIS3DH (RAK1904, slot A, I2C 0x18) -> 500-sample ring buffer
 *           -> features.h (13 features) -> fan_model.h (emlearn RF) -> serial + LEDs
 *
 * Build:  see ../platformio.ini. Generate fan_model.h / test_windows.h with
 *         train_rf.py first.
 * Serial: 115200 baud.
 */

#include <Arduino.h>
#include <Wire.h>
#include <Adafruit_LIS3DH.h>
#include <Adafruit_Sensor.h>

#include "features.h"
#include "fan_model.h"     // generated by train_rf.py (emlearn, method='inline')
#include "feature_scale.h" // generated by train_rf.py (int16 quantisation)
#include "test_windows.h"  // generated by train_rf.py (golden windows)

// ---- Configuration (MUST match train_rf.py) --------------------------------
#define RUN_STATIC_TESTS 1 // 1 = validate golden windows on boot, then halt
#define SAMPLE_RATE_HZ 250 // course-wide rate; must match train_rf.py
#define WINDOW_LEN 500     // samples per inference window (2 s)
#define HOP_LEN 250        // 50 % overlap -> one prediction per second

Adafruit_LIS3DH lis;

// Ring buffer of interleaved x,y,z samples. Inference copies the most recent
// WINDOW_LEN samples into a linear buffer -> same effect as the double-buffer
// scheme from the old course, with less bookkeeping.
static float ring[WINDOW_LEN * 3];
static volatile uint32_t total_samples = 0;
static float window_buf[WINDOW_LEN * 3];
static float features[N_FEATURES];     // as computed, in physical units (m/s^2 etc.)
static int16_t features_q[N_FEATURES]; // as the model sees them (see feature_scale.h)

static void set_leds(int cls)
{
    // class_names[] order comes from test_windows.h (alphabetical).
    const char *name = (cls >= 0 && cls < TEST_N_CLASSES) ? class_names[cls] : "?";
    const bool is_normal = (strcmp(name, "normal") == 0);
    const bool is_off = (strcmp(name, "off") == 0);
    digitalWrite(LED_GREEN, is_normal ? HIGH : LOW);
    digitalWrite(LED_BLUE, (!is_normal && !is_off) ? HIGH : LOW);
}

// micros() on this core is dwt_enabled()
static inline void dwt_timing_enable(void)
{
    CoreDebug->DEMCR |= CoreDebug_DEMCR_TRCENA_Msk;
    DWT->CYCCNT = 0;
    DWT->CTRL |= DWT_CTRL_CYCCNTENA_Msk;
}

static int classify(const float *buf, uint32_t *feat_us, uint32_t *model_us)
{
    uint32_t t0 = micros();
    calculate_features(buf, WINDOW_LEN, features);
    // Same scale train_rf.py used — the model's thresholds are integers in
    // THESE units, so a mismatch here moves every decision boundary silently.
    quantise_features(features, feature_scale, features_q);
    uint32_t t1 = micros();
    // emlearn's tree runtime is fixed-point, so the generated signature is
    // int32_t fan_model_predict(const int16_t *features, int32_t n_features).
    int cls = (int)fan_model_predict(features_q, N_FEATURES);
    uint32_t t2 = micros();
    *feat_us = t1 - t0;
    *model_us = t2 - t1;
    return cls;
}

static void run_static_tests()
{
    Serial.println("--- static golden-window tests (4-step ladder, step 3) ---");
    int failures = 0;
    for (int i = 0; i < TEST_N_WINDOWS; i++)
    {
        uint32_t feat_us, model_us;
        int cls = classify(test_windows[i], &feat_us, &model_us);
        bool pass = (cls == test_expected[i]);
        if (!pass)
            failures++;
        Serial.printf("[static] window '%s' -> predicted '%s'  %s  (feat %lu us, model %lu us)\n",
                      class_names[test_expected[i]],
                      (cls >= 0 && cls < TEST_N_CLASSES) ? class_names[cls] : "?",
                      pass ? "PASS" : "FAIL",
                      (unsigned long)feat_us, (unsigned long)model_us);
        if (!pass)
        {
            // Diff these against `python train_rf.py --print-features`. Floats
            // differing => the feature code drifted; floats matching but ints
            // differing => feature_scale.h is stale (regenerate model + scales).
            for (int f = 0; f < N_FEATURES; f++)
            {
                Serial.printf("           feat[%2d] %12.6f  x%-9g -> %6d\n",
                              f, (double)features[f], (double)feature_scale[f],
                              (int)features_q[f]);
            }
        }
    }
    Serial.printf("--- %d/%d passed. %s ---\n", TEST_N_WINDOWS - failures, TEST_N_WINDOWS,
                  failures ? "Fix before going live!" : "Set RUN_STATIC_TESTS 0 and go live.");
}

void setup()
{
    dwt_timing_enable(); // 15.6 ns micros(); also de-jitters the loop deadline

    // --- WisBlock ritual: power the sensor-slot 3V3_S rail. Do not delete. ---
    pinMode(WB_IO2, OUTPUT);
    digitalWrite(WB_IO2, HIGH);
    delay(100); // give the sensor time to boot

    Serial.begin(115200);
    uint32_t t_wait = millis();
    while (!Serial && millis() - t_wait < 5000)
    {
        delay(10);
    } // wait for USB CDC

    pinMode(LED_GREEN, OUTPUT);
    pinMode(LED_BLUE, OUTPUT);

    Serial.println("Module 7.1 - RF fan classifier (emlearn)");

#if RUN_STATIC_TESTS
    // Static tests run BEFORE the sensor check on purpose: golden-window
    // validation needs no hardware, so a missing/unseated RAK1904 must not
    // block step 4 of the README.
    while (1)
    {
        run_static_tests();
        delay(3000);
    } // halt after tests
#endif

    if (!lis.begin(0x18))
    { // RAK1904 in sensor slot A
        Serial.println("ERROR: LIS3DH not found at 0x18 - check slot A seating and WB_IO2.");
        while (1)
        {
            digitalWrite(LED_BLUE, !digitalRead(LED_BLUE));
            delay(200);
        }
    }
    lis.setRange(LIS3DH_RANGE_4_G);
    lis.setDataRate(LIS3DH_DATARATE_400_HZ); // ODR must EXCEED our 250 Hz polling
                                             // rate, or every poll re-reads the same
                                             // OUT registers (duplicated samples)

    Serial.printf("Sampling live at %d Hz, prediction every %d samples (%.1f s)...\n",
                  SAMPLE_RATE_HZ, HOP_LEN, (double)HOP_LEN / SAMPLE_RATE_HZ);
}

void loop()
{
    static uint32_t next_sample_us = 0;
    static uint32_t samples_since_infer = 0;

    const uint32_t now = micros();
    if (next_sample_us == 0)
        next_sample_us = now;
    if ((int32_t)(now - next_sample_us) < 0)
        return;
    next_sample_us += 1000000UL / SAMPLE_RATE_HZ;

    // --- sample -------------------------------------------------------------
    sensors_event_t event;
    lis.getEvent(&event); // m/s^2
    const uint32_t idx = (total_samples % WINDOW_LEN) * 3;
    ring[idx + 0] = event.acceleration.x;
    ring[idx + 1] = event.acceleration.y;
    ring[idx + 2] = event.acceleration.z;
    total_samples++;
    samples_since_infer++;

    // --- infer every HOP_LEN samples once the window is full ----------------
    if (total_samples >= WINDOW_LEN && samples_since_infer >= HOP_LEN)
    {
        samples_since_infer = 0;

        // Unroll ring so window_buf is chronological (features are order-
        // insensitive statistics, but golden-window parity is worth keeping).
        const uint32_t head = total_samples % WINDOW_LEN;
        for (uint32_t i = 0; i < WINDOW_LEN; i++)
        {
            const uint32_t src = ((head + i) % WINDOW_LEN) * 3;
            window_buf[i * 3 + 0] = ring[src + 0];
            window_buf[i * 3 + 1] = ring[src + 1];
            window_buf[i * 3 + 2] = ring[src + 2];
        }

        uint32_t feat_us, model_us;
        const int cls = classify(window_buf, &feat_us, &model_us);
        set_leds(cls);
        Serial.printf("%-10s feat %5lu us  model %5lu us  total %5lu us\n",
                      (cls >= 0 && cls < TEST_N_CLASSES) ? class_names[cls] : "?",
                      (unsigned long)feat_us, (unsigned long)model_us,
                      (unsigned long)(feat_us + model_us));
    }
}
